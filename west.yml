## west.yml
```yaml
manifest:
  # lowest version of the manifest file schema that can parse this file’s data
  version: 0.8

  projects:
    - name: zephyr
      url: https://github.com/zephyrproject-rtos/zephyr
      revision: v3.4.0
      west-commands: scripts/west-commands.yml
      # import everything listed in zephyr's west.yml file and put in under deps folder.
      import:
        path-prefix: deps
    - name: app_glen
      url: https://github.com/rmarco30/app_glen
      revision: master
      import: false # optional. by default nothing will be imported.
    - name: app_x
      url: https://github.com/rmarco30/app_x
      revision: 57aff2e
      # no imports, same as app_glen

  # Settings applied using the self key will only be applied to the manifest repository
self:
  path: app_eric
```
